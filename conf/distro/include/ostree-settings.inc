## conf/distro/include/ostree-settings.inc
```bitbake
# Define OSTree sample keys directory
OSTREE_SAMPLE_KEYS_DIR ?= "${LAYER_PATH_lat-layer}/conf/distro/files/ostree-sample-keys"
OSTREE_KEYS_DIR ?= "${OSTREE_SAMPLE_KEYS_DIR}"

OSTREE_INITRAMFS_IMAGE ?= "initramfs-ostree-image"
OSTREE_REPO ??= "${DEPLOY_DIR_IMAGE}/ostree_repo"

OSTREE_BRANCHNAME ??= "${IMAGE_BASENAME}"
OSTREE_OSNAME ??= "lat_os"
# This is set to the name of the loader to include into a disk image
# Not all BSPs will need this, so it can be unset by the BSP
OSTREE_BOOTLOADER_INCLUDE ??= "${OSTREE_BOOTLOADER}"
OSTREE_KERNEL_ARGS ??= "ro rootwait"

# The OSTREE_SKIP_BOOT_DIFF can be one of the following:
#   0 = Perform a full fsck and boot diff
#   1 = Skip the FSCK check
#   2 = Skip the FSCK and the boot
OSTREE_SKIP_BOOT_DIFF ??= "2"

OSTREE_GPGID ??= "OSTree-Sample-Key"
OSTREE_GPG_PASSPHRASE ??= "ostree"
OSTREE_GPGDIR ??= "${OSTREE_KEYS_DIR}/rpm_keys"

# Generate rootfs.ostree.tar.bz2 files which could be used to build a new repo
# OSTREE_CREATE_TARBALL = "1"

# Configuration of image upgrade and install variables

OSTREE_USE_AB ??= "0"
OSTREE_REMOTE_NAME ??= "${OSTREE_OSNAME}"
OSTREE_REMOTE_URL ??= ""

# WIC wks configuration variables follow
# The selection of the wks file is:
#   Bootloader - ab/noab

OSTREE_ARCH_WKS:x86 ??= "ostree-grub"
OSTREE_ARCH_WKS:x86-64 ??= "ostree-grub"

OSTREE_ARCH_WKS:arm ??= "ostree-uboot-sd"
OSTREE_ARCH_WKS:armv7 ??= "ostree-uboot-sd"
OSTREE_ARCH_WKS:armv7ve ??= "ostree-uboot-sd"
OSTREE_ARCH_WKS:aarch64 ??= "ostree-uboot-sd"

OSTREE_AB_WKS ??= "${@oe.utils.conditional('OSTREE_USE_AB', '1', '-ab', '-noab', d)}"

OSTREE_USE_FIT ??= "0"

# Set a fixed size in the wks file for the various partitions from local.conf e.g.
#OSTREE_WKS_EFI_SIZE = "--size=32M --overhead-factor 1"
#OSTREE_WKS_BOOT_SIZE = "--size=300M --overhead-factor 1"
#OSTREE_WKS_ROOT_SIZE = "--size=1024M --overhead-factor 1"
#OSTREE_WKS_FLUX_SIZE = "--size=1024M --overhead-factor 1"

OSTREE_WKS_EFI_SIZE ??= "--size=32M"
OSTREE_WKS_BOOT_SIZE ??= ""
OSTREE_WKS_ROOT_SIZE ??= ""
OSTREE_WKS_FLUX_SIZE ??= ""

# Parition type for /var
OSTREE_FLUX_PART ??= "${@bb.utils.contains('DISTRO_FEATURES', 'luks', 'luksfluxdata', 'fluxdata',d)}"

# Name of the boot loader to include in the file system
OSTREE_BOOTLOADER:x86 ??= 'grub'
OSTREE_BOOTLOADER:x86-64 ??= 'grub'
OSTREE_BOOTLOADER:arm ??= 'u-boot'
OSTREE_BOOTLOADER:armv7 ??= 'u-boot'
OSTREE_BOOTLOADER:armv7ve ??= 'u-boot'
OSTREE_BOOTLOADER:aarch64 ??= 'u-boot'

# Define any special partitions required where loaders, firmware etc
# live It is intended that these are defined by the BSP as needed
OSTREE_SD_UBOOT_WIC1 ??= "part / --source rawcopy --sourceparams="file=${UBOOT_BINARY}" --ondisk mmcblk --no-table --align 1 --size 1"
OSTREE_SD_UBOOT_WIC2 ??= ""
OSTREE_SD_UBOOT_WIC3 ??= ""
OSTREE_SD_UBOOT_WIC4 ??= ""

# The OSTREE_CONSOLE variable will control what kernel command line
# parameters are passed for the console these should be formatted for
# the boot loader specific to the BSP and the OSTREE_CONSOLE_AUX
# should end with a SPACE
OSTREE_CONSOLE_PRI ??= "console=tty1"
OSTREE_CONSOLE_PRI:arm ??= "console=\${console},\${baudrate}"
OSTREE_CONSOLE_PRI:armv7 ??= "console=\${console},\${baudrate}"
OSTREE_CONSOLE_PRI:armv7ve ??= "console=\${console},\${baudrate}"
OSTREE_CONSOLE_PRI:aarch64 ??= "console=\${console},\${baudrate}"

OSTREE_CONSOLE_AUX ??= "console=ttyS0,115200 "
OSTREE_CONSOLE_AUX:x86 ??= "console=ttyS0,115200 "
OSTREE_CONSOLE_AUX:x86-64 ??= "console=ttyS0,115200 "
OSTREE_CONSOLE_AUX:arm ??= "console=tty0 "
OSTREE_CONSOLE_AUX:armv7 ??= "console=tty0 "
OSTREE_CONSOLE_AUX:armv7ve ??= "console=tty0 "
OSTREE_CONSOLE_AUX:aarch64 ??= "console=tty0 "

OSTREE_CONSOLE ??= "${OSTREE_CONSOLE_AUX}${OSTREE_CONSOLE_PRI}"

# This is set to the name of the loader to include into a disk image
# Not all BSPs will need this, so it can be unset by the BSP
OSTREE_SD_BOOT_ALIGN ??= "4"

# Copy the IMAGE_BOOT_FILES when generating the ostree boot partition
OSTREE_COPY_IMAGE_BOOT_FILES ??= "0"

# Use this WKS file with wic (WKS_FILE = "${OSTREE_WKS_FILE}" should be set in the feature
# template or local.conf
OSTREE_WKS_FILE ??= "${OSTREE_ARCH_WKS}${OSTREE_AB_WKS}.wks.in"

# Below are additional variables that can be set in local.conf which are the
# defaults for the network installer

# Boot Loader Magic block offset (where the first partition should start in sectors)
# NOTE: The FSZ, BSZ and RSZ are numeric in MB only e.g. OSTREE_FDISK_FSZ = "64"
OSTREE_FDISK_BLM ??= "2506"
# Size of the Fat / EFI partition
OSTREE_FDISK_FSZ ??= "32"
# Size of the Boot partition
OSTREE_FDISK_BSZ ??= "200"
# Size of the Root partition
OSTREE_FDISK_RSZ ??= "1400"
# Size of the /var partition 0 for fill disk
OSTREE_FDISK_VSZ ??= "0"

# Allow the var directory to be erased via the initramfs boot, when
# using "ostree_upgrade.sh -e".  The default is 1, but for very secure
# targets this could be a dangerous operation so it is configurable.
# OSTREE_ALLOW_RM_VAR = "0"

# What uboot command should be used to start the kernel in the boot.scr file
# OSTREE_UBOOT_CMD ??= "bootz"

# Use file system links for the ostree boot mounts (more secure and the default)
#    OSTREE_BOOTSCR ??= "fs_links"
# Or read a uEnv.txt file from the disk which allows kernel args 
# to be controlled via ostree (less secure)
#    OSTREE_BOOTSCR ??= "env_import"

# Allow a BSP to specify extra cmds in the boot.scr if needed
OSTREE_BOOTSCR_PRECMD ??= ""

# Grub settings for ostree
OSTREE_GRUB_USER ??= "root"
# Default password is root found in the file below, which is a generated hash
OSTREE_GRUB_PW_FILE ??= "${OSTREE_KEYS_DIR}/boot_keys/boot_cfg_pw"

OSTREE_SUPPORTED_ARM64_MACHINES ??= " \
    bcm-2xxx-rpi4 \
    xilinx-zynqmp \
    nxp-imx8 \
    marvell-cn96xx \
    nxp-s32g \
    intel-socfpga-64 \
    ti-j72xx \
    aptiv_cvc_sousa \
    axxiaarm64 \
    nxp-ls1043 \
    nxp-lx2xxx \
"

OSTREE_SUPPORTED_ARM32_MACHINES ??= " \
    xilinx-zynq \
    nxp-imx6 \
    nxp-ls1028 \
    axxiaarm \
"

OSTREE_SUPPORTED_ARM_MACHINES ?= " \
    ${OSTREE_SUPPORTED_ARM64_MACHINES} \
    ${OSTREE_SUPPORTED_ARM32_MACHINES} \
"

OSTREE_KERNEL ??= "${KERNEL_IMAGETYPE}"
RAMDISK_EXT ?= ".${INITRAMFS_FSTYPES}"

BOOTFILES ??= ""

OSTREE_WIFI_PACKAGES ??= ""
OSTREE_WIFI_PACKAGES:intel-x86-64 = " \
    packagegroup-base-wifi \
    linux-firmware-iwlwifi-6000g2a-6 \
    linux-firmware-iwlwifi-6000g2b-6 \
    linux-firmware-iwlwifi-135-6 \
    linux-firmware-iwlwifi-8000c \
    linux-firmware-iwlwifi-8265 \
    linux-firmware-iwlwifi-7265d \
    linux-firmware-iwlwifi-9000 \
    linux-firmware-iwlwifi-misc \
    kernel-module-iwlmvm \
    kernel-module-iwlwifi \
"
```

## conf/distro/lat.conf
```bitbake
DISTRO_FEATURES:append = ' lat'
DISTRO_FEATURES_NATIVESDK:append = ' lat'
DISTRO_FEATURES_NATIVE:append = ' lat'

# Vbox Guest Additions
COMPATIBLE_MACHINE:pn-vboxguestdrivers = "intel-x86-64"
EXTRA_IMAGEDEPENDS:append:intel-x86-64 = " vboxguestdrivers"

LAT_DEFAULT_IMAGE ?= "lat-image-base"

VIRTUAL-RUNTIME_base-utils = "packagegroup-core-base-utils"

# Disable multilib
MULTILIBS = ""
baselib = "lib"

# For docker
DISTRO_FEATURES:append = " virtualization"

IMAGE_CLASSES:append = " lat_sdk"
```

## conf/distro/ostree.conf
```bitbake
#
# Copyright (C) 2021 Wind River Systems, Inc.
#

require conf/distro/include/ostree-settings.inc

DISTRO_FEATURES:append = " ostree usrmerge"
DISTRO_FEATURES_NATIVESDK:append = ' ostree'
DISTRO_FEATURES_NATIVE:append = ' ostree'

INITRAMFS_IMAGE_INSTALL = "1"
INITRAMFS_IMAGE="${OSTREE_INITRAMFS_IMAGE}"
INITRAMFS_FSTYPES = "${@oe.utils.ifelse(d.getVar('OSTREE_BOOTLOADER', True) == 'u-boot', 'cpio.gz.u-boot', 'cpio.gz')}"

WKS_FILE = "${OSTREE_WKS_FILE}"

EXTRA_IMAGEDEPENDS:append = " util-linux-native"
EXTRA_IMAGEDEPENDS:append = " perl-native"
EXTRA_IMAGEDEPENDS:append = " bmap-tools-native"

IMAGE_CLASSES += "flux-ota"

IMAGE_INSTALL:append = " ${@bb.utils.contains('OSTREE_BOOTLOADER', 'u-boot', 'u-boot-uenv', '', d)}"

# ostree
PREFERRED_VERSION_ostree ?= "2019.1+gitAUTOINC+6649032a37"
PREFERRED_VERSION_ostree-native ?= "2019.1+gitAUTOINC+6649032a37"
PREFERRED_VERSION_nativesdk-ostree ?= "2019.1+gitAUTOINC+6649032a37"
```

## conf/layer.conf
```bitbake
# We have a conf and classes directory, add to BBPATH
BBPATH =. "${LAYERDIR}:"

# We have recipes-* directories, add to BBFILES
BBFILES += " \
    ${LAYERDIR}/recipes-*/*/*.bb \
    ${LAYERDIR}/recipes-*/*/*.bbappend"

BBFILES_DYNAMIC += "\
    efi-secure-boot:${LAYERDIR}/dynamic-layers/meta-efi-secure-boot/recipes-*/*/*.bbappend \
"

BBFILE_COLLECTIONS += "lat-layer"
BBFILE_PATTERN_lat-layer = "^${LAYERDIR}/"
BBFILE_PRIORITY_lat-layer = "6"

LAYERDEPENDS_lat-layer = " \
    core \
    openembedded-layer \
    filesystems-layer \
    meta-python \
    virtualization-layer \
    networking-layer \
    xfce-layer \
    gnome-layer \
    multimedia-layer \
    ${@bb.utils.contains('DISTRO_FEATURES', 'efi-secure-boot', 'efi-secure-boot', '', d)} \
"

LAYERSERIES_COMPAT_lat-layer = "kirkstone"

NON_MULTILIB_RECIPES:append = " u-boot-uenv"

LAYER_PATH_lat-layer = "${LAYERDIR}"
```

## conf/machine/include/qemu-intel-x86.inc
```bitbake
# Similar to meta/conf/machine/include/qemu.inc but influences the
# distro content (in particular the kernel) less than qemu.inc.

# Ensure that qemu gets built when building images.
EXTRA_IMAGEDEPENDS += "qemu-native qemu-helper-native"

# Build ovmf firmware for uefi support in qemu.
EXTRA_IMAGEDEPENDS += "ovmf"
```

## conf/machine/intel-x86-64.conf
```bitbake
INTEL_X86_64_CONF ?= ""
INTEL_X86_64_CONF:poky = "conf/machine/poky/intel-x86-64.conf"
require ${INTEL_X86_64_CONF}
```

## conf/machine/intel-x86.inc
```bitbake
#
# Copyright (C) 2017 Wind River Systems, Inc.
#

MACHINE_FEATURES += "x86 pci usbhost ext2 keyboard screen alsa acpi vfat serial"
MACHINE_FEATURES += "efi pcbios"
MACHINE_FEATURES += "parser shell-tools filesystem profile network"

MACHINE_EXTRA_RRECOMMENDS += "linux-firmware-iwlwifi-6000g2a-6"
MACHINE_EXTRA_RRECOMMENDS += "linux-firmware-iwlwifi-6000g2b-6"
MACHINE_EXTRA_RRECOMMENDS += "linux-firmware-iwlwifi-135-6"
MACHINE_EXTRA_RRECOMMENDS += "linux-firmware-bnx2-mips"
MACHINE_EXTRA_RRECOMMENDS += "linux-firmware-iwlwifi-8000c"
MACHINE_EXTRA_RRECOMMENDS += "linux-firmware-iwlwifi-8265"
MACHINE_EXTRA_RRECOMMENDS += "linux-firmware-radeon"
MACHINE_EXTRA_RRECOMMENDS += "linux-firmware-pcie8897"
MACHINE_EXTRA_RRECOMMENDS += "linux-firmware-iwlwifi-7265d"
MACHINE_EXTRA_RRECOMMENDS += "linux-firmware-i915"
MACHINE_EXTRA_RRECOMMENDS += "linux-firmware-ibt-12-16"
MACHINE_EXTRA_RRECOMMENDS += "linux-firmware-rtl8723"
MACHINE_EXTRA_RRECOMMENDS += "linux-firmware-ibt-17"
MACHINE_EXTRA_RRECOMMENDS += "linux-firmware-iwlwifi-9000"
MACHINE_EXTRA_RRECOMMENDS += "linux-firmware-ice"

MACHINE_EXTRA_RRECOMMENDS += "linux-firmware-iwlwifi-misc"
MACHINE_EXTRA_RRECOMMENDS += "linux-firmware-ibt-misc"

EFI_PROVIDER ?= "${@bb.utils.contains('INCOMPATIBLE_LICENSE', 'GPLv3', 'systemd-boot', 'grub-efi', d)}"

# grub-efi is depended in wic.bbclass, remove it to aviod depency error.
WKS_FILE_DEPENDS_BOOTLOADERS_remove = "${@bb.utils.contains('INCOMPATIBLE_LICENSE', 'GPLv3', 'grub-efi', '', d)}"

# Do not include installer routine when GPLv3 is not allowed.
INITRAMFS_SCRIPTS_remove = "${@bb.utils.contains('INCOMPATIBLE_LICENSE', 'GPLv3', 'initramfs-module-install initramfs-module-install-efi', '', d)}"
LABELS_LIVE_remove = "${@bb.utils.contains('INCOMPATIBLE_LICENSE', 'GPLv3', 'install', '', d)}"

KERNEL_IMAGETYPE = "bzImage"

SERIAL_CONSOLES = "115200;ttyS0 115200;ttyUSB0"

MACHINEOVERRIDES_append = ":intel-x86"

XSERVER ?= "xserver-xorg \
	   xserver-xorg-extension-dri \
	   xserver-xorg-extension-dri2 \
	   xserver-xorg-extension-extmod \
	   xserver-xorg-extension-dbe \
	   xserver-xorg-module-libint10 \
	   xf86-input-mouse \
	   xf86-input-keyboard \
	   xf86-input-evdev \
	   xf86-input-synaptics \
	   xf86-video-vesa \
	   xf86-video-fbdev \
	   xf86-video-mga \
	   xf86-video-modesetting \
	   \
	   ${@bb.utils.contains('DISTRO_FEATURES', 'opengl', 'mesa-driver-swrast xserver-xorg-extension-glx', '', d)} \
	   ${@bb.utils.contains('DISTRO_FEATURES', 'opengl', 'mesa-driver-i915 mesa-driver-i965', '', d)} \
	   ${@bb.utils.contains('DISTRO_FEATURES', 'opengl', 'mesa mesa-demos', '', d)} \
	   ${@bb.utils.contains('DISTRO_FEATURES', 'opengl', 'xf86-video-ati xf86-video-intel', '', d)} \
	   matchbox-wm"

PREFERRED_PROVIDER_libglu = "libglu"
PREFERRED_VERSION_virtual/mesa = "17.1.5"

PREFERRED_PROVIDER_virtual/kernel ??= "linux-yocto"
PREFERRED_VERSION_linux-yocto ?= "5.10%"

TARGET_QEMU_BIN = "qemu-system-x86_64"
TARGET_QEMU_KERNEL="bzImage"
TARGET_QEMU_KERNEL_OPTS="selinux=0 enforcing=0"
TARGET_QEMU_ENET_MODEL="i82557b"
TARGET_QEMU_BOOT_CONSOLE="ttyS0,115200"
TARGET_QEMU_OPTS="-show-cursor -usb -usbdevice wacom-tablet -vga vmware"
TARGET_QEMU_CPU="Nehalem"

IMAGE_FSTYPES += "live wic wic.bmap"

WKS_FILE ?= "${@bb.utils.contains('INCOMPATIBLE_LICENSE', 'GPLv3', 'systemd-bootdisk.wks', 'intel-x86-mkefidisk.wks', d)}"
do_image_wic[depends] += "gptfdisk-native:do_populate_sysroot"
do_image_wic[recrdeptask] += "do_bootimg"

# DPDK enable and configuration
COMPATIBLE_MACHINE_intel-x86_pn-dpdk = "${MACHINE}"
PREFERRED_VERSION_dpdk ?= "19.11.%"
```

## conf/machine/poky/include/qemuboot-intel-x86.inc
```bitbake
QB_MEM ?= "-m 1024"
IMAGE_CLASSES += "qemuboot"

QB_SYSTEM_NAME:intel-x86-64 = "qemu-system-x86_64"
QB_CPU:intel-x86-64 = "-cpu Nehalem"
QB_CPU_KVM:intel-x86-64 = "-cpu kvm64"

QB_AUDIO_DRV = "alsa"
QB_AUDIO_OPT = "-soundhw ac97,es1370"
QB_KERNEL_CMDLINE_APPEND = "oprofile.timer=1"
QB_OPT_APPEND = "-vga std -device usb-mouse -usb -device usb-tablet"
```
